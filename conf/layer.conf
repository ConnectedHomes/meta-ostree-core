## conf/layer.conf
```bitbake
# We have a conf and classes directory, add to BBPATH
BBPATH .= ":${LAYERDIR}"

# We have recipes-* directories, add to BBFILES
BBFILES += "${LAYERDIR}/recipes-*/*/*.bb \
	${LAYERDIR}/recipes-*/*/*.bbappend"

BBFILES_DYNAMIC += " \
    core:${LAYERDIR}/bbappends/openembedded-core/meta/*/*/*.bbappend \
"

BBFILE_COLLECTIONS += "ostree-core"
BBFILE_PATTERN_ostree-core = "^${LAYERDIR}/"
BBFILE_PRIORITY_ostree-core = "7"

LAYERSERIES_COMPAT_ostree-core = "sumo thud warrior zeus dunfell gatesgarth hardknott honister kirkstone langdale"

# Set a variable to get to the top of the IoT Reference OS Kit metadata location
META_OSTREE_CORE_BASE := '${LAYERDIR}'
```
